VERSION ""

NS_ :

BS_:

BU_: XXX

BO_ 513 powertrain: 8 XXX
 SG_ kph : 39|8@0+ (0.5,0) [0|255] "kph" XXX
 SG_ rpm : 7|16@0+ (4,0) [0|65535] "rpm" XXX
